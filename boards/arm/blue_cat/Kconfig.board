## boards/arm/blue_cat/Kconfig.board
```kconfig
# Copyright 2024 Cheng Sheng
# SPDX-License-Identifier: Apache-2.0

config BOARD_BLUE_CAT
  bool "Blue cat board"
  depends on SOC_NRF52840_QIAA
```

## boards/arm/blue_cat/Kconfig.defconfig
```kconfig
# Copyright 2024 Cheng Sheng
# SPDX-License-Identifier: Apache-2.0

if BOARD_BLUE_CAT

config BOARD
  default "blue_cat"

# Enable the Bluetooth controller if BT is enabled.
config BT_CTLR
  default BT

endif  # BOARD_BLUE_CAT
```

## boards/arm/blue_cat/blue_cat_defconfig
```kconfig
# Copyright 2024 Cheng Sheng
# SPDX-License-Identifier: Apache-2.0

# Board itself.
CONFIG_BOARD_BLUE_CAT=y
# MCU.
CONFIG_SOC_NRF52840_QIAA=y
CONFIG_SOC_SERIES_NRF52X=y
# Memory protections.
CONFIG_ARM_MPU=y
CONFIG_HW_STACK_PROTECTION=y
```

## boards/arm/cat/Kconfig.board
```kconfig
# Copyright 2024 Cheng Sheng
# SPDX-License-Identifier: Apache-2.0

config BOARD_CAT
  bool "The (blue) cat board: BLE+GPIO sensing."
  depends on SOC_NRF52840_QIAA
```

## boards/arm/cat/Kconfig.defconfig
```kconfig
# Copyright 2024 Cheng Sheng
# SPDX-License-Identifier: Apache-2.0

if BOARD_CAT

config BOARD
  default "cat"

# Enable the Bluetooth controller if BT is enabled.
config BT_CTLR
  default BT

endif  # BOARD_CAT
```

## boards/riscv/chihuahua/Kconfig.board
```kconfig
# Copyright 2024 Cheng Sheng
# SPDX-License-Identifier: Apache-2.0

config BOARD_CHIHUAHUA
  bool "Chihuahua board"
  depends on SOC_SERIES_ESP32C3
```

## boards/riscv/chihuahua/Kconfig.defconfig
```kconfig
# Copyright 2024 Cheng Sheng
# SPDX-License-Identifier: Apache-2.0

if BOARD_CHIHUAHUA

config BOARD
  default "chihuahua"

config HEAP_MEM_POOL_ADD_SIZE_BOARD
  int
  default 98304  # Big enough for WIFI. Why does everyone use this number?

choice BT_HCI_BUS_TYPE
  default BT_ESP32 if BT
endchoice

endif  # BOARD_CHIHUAHUA
```

## boards/riscv/dog/Kconfig.board
```kconfig
# Copyright 2024 Cheng Sheng
# SPDX-License-Identifier: Apache-2.0

config BOARD_DOG
  bool "Dog board"
  depends on SOC_SERIES_ESP32C3
```

## boards/riscv/dog/Kconfig.defconfig
```kconfig
# Copyright 2024 Cheng Sheng
# SPDX-License-Identifier: Apache-2.0

if BOARD_DOG

config BOARD
  default "dog"

config HEAP_MEM_POOL_ADD_SIZE_BOARD
  int
  default 98304  # Big enough for WIFI. Why does everyone use this number?

choice BT_HCI_BUS_TYPE
  default BT_ESP32 if BT
endchoice

endif  # BOARD_DOG
```

## boards/riscv/dog/dog_defconfig
```kconfig
# Copyright 2024 Cheng Sheng
# SPDX-License-Identifier: Apache-2.0

# Board itself.
CONFIG_BOARD_DOG=y
# MCU
CONFIG_SOC_SERIES_ESP32C3=y
CONFIG_MAIN_STACK_SIZE=2048
# Memory protections. https://shorturl.at/yzKSX
# The option at ESP level doesn't seem to be exposed in Zephyr. Fortnuately the
# the default is true.

# Debug message console.
CONFIG_SERIAL=y
CONFIG_CONSOLE=y
CONFIG_UART_CONSOLE=y
```

## lib/Kconfig
```kconfig
# SPDX-License-Identifier: Apache-2.0

rsource "central/Kconfig"
rsource "peripheral/Kconfig"
```

## lib/central/Kconfig
```kconfig
# SPDX-License-Identifier: Apache-2.0

config BLUE_CAT_CENTRAL
    bool "Enable central lib."
    select BT
    select BT_CENTRAL
    select BT_SMP
    help
        This option enables the central lib of the BlueCat project.

config BLUE_CAT_CENTRAL_CONN_LOG_LEVEL
    int "The log level of lib/central/conn.c."
    default LOG_MAX_LEVEL
```

## lib/peripheral/Kconfig
```kconfig
# SPDX-License-Identifier: Apache-2.0

config BLUE_CAT_PERIPHERAL
    bool "Enable peripheral lib (but not individual modules)."
    select BT
    select BT_PERIPHERAL
    select BT_BAS
    # Security.
    select BT_BONDABLE
    select BT_SMP
    select BT_SMP_SC_ONLY
    help
        This option enables the peripheral lib of the BlueCat project.

config BLUE_CAT_PERIPHERAL_CONN
    bool "Enable peripheral connection loop module."
    select BLUE_CAT_PERIPHERAL

config BLUE_CAT_PERIPHERAL_DOORBELL
    bool "Enable peripheral doorbell service GATT."
    select BLUE_CAT_PERIPHERAL
    select BT_GATT_SERVER

config BLUE_CAT_PERIPHERAL_CONN_LOG_LEVEL
    int "The log level of lib/peripheral/conn.c."
    default LOG_MAX_LEVEL
```

## tests/lib/central/conn/testcase.yaml
```yaml
common:
  platform_allow:
    - native_sim
  integration_platforms:
    - native_sim
  harness: pytest
tests:
  blue_cat.central.conn:
    tags: bluetooth
```

## tests/lib/peripheral/gatt_doorbell/testcase.yaml
```yaml
common:
  platform_allow:
    - native_sim
  integration_platforms:
    - native_sim
  harness: pytest
tests:
  blue_cat.peripheral.gatt_doorbell:
    tags: bluetooth
```

## west.yml
```yaml
manifest:
  self:
      west-commands: west/west-commands.yml
  remotes:
    - name: zephyrproject-rtos
      url-base: https://github.com/zephyrproject-rtos
  projects:
    - name: zephyr
      remote: zephyrproject-rtos
      revision: main
      import: true
```
